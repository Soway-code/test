## board/Kconfig
```kconfig
menu "Hardware Drivers Config"

config SOC_STM32L072CB
    bool
    select SOC_SERIES_STM32L0
    select RT_USING_COMPONENTS_INIT
    select RT_USING_USER_MAIN
    default y

menu "Onboard Peripheral Drivers"

    config BSP_USING_USB_TO_USART
        bool "Enable USB TO USART (uart2)"
        select BSP_USING_UART2
        default y

endmenu
menu "On-chip Peripheral Drivers"

    config BSP_USING_GPIO
        bool "Enable GPIO"
        select RT_USING_PIN
        default y
    config BSP_USING_ON_CHIP_FLASH
        bool "Enable FLASH"
        default y
    menuconfig BSP_USING_UART
        bool "Enable UART"
        default y
        select RT_USING_SERIAL
        if BSP_USING_UART
            config BSP_USING_UART2
                bool "Enable UART2"
                default y
			config BSP_USING_UART1
                bool "Enable UART1"
                default y	
            config BSP_USING_UART4
                bool "Enable UART4"
                default y	 
                
            config BSP_UART2_RX_USING_DMA
                bool "Enable UART2 RX DMA"
                depends on BSP_USING_UART2 && RT_SERIAL_USING_DMA
                default y
            config BSP_UART1_RX_USING_DMA
                bool "Enable UART1 RX DMA"
                depends on BSP_USING_UART1 && RT_SERIAL_USING_DMA
                default y
            config BSP_UART4_RX_USING_DMA
                bool "Enable UART4 RX DMA"
                depends on BSP_USING_UART4 && RT_SERIAL_USING_DMA
                default y    
            config temp_SERIES_SAMPLE_USING_DMA
                bool "Enable UART DMA"
                default n      
        endif
    source "libraries/HAL_Drivers/Kconfig"
    
endmenu

menu "Board extended module Drivers"

endmenu

endmenu
```
